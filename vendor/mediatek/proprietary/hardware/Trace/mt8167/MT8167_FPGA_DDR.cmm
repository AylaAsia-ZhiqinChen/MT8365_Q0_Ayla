
&NR_RNKS=2
; EMI setting
if &NR_RNKS==2
(
D.S SD:0x10205000 %LE %LONG 0x00025302; EMI_CONA
;D.S SD:0x10205000 %LE %LONG 0x0002A352; EMI_CONA
)
else
(
D.S SD:0x10205000 %LE %LONG 0x00002112; EMI_CONA
)
D.S SD:0x10205060 %LE %LONG 0x00000400; EMI_CONM
;D.S SD:0x102050E8 %LE %LONG 0x00000800; EMI_DFTB
;D.S SD:0x10205000 %LE %LONG 0x0002A35A; EMI_CONA
;D.S SD:0x10205060 %LE %LONG 0x00000700; EMI_CONM
;D.S SD:0x10205140 %LE %LONG 0x10402488; EMI_ARBI
;D.S SD:0x10205100 %LE %LONG 0x4010580e; EMI_ARBA
;D.S SD:0x10205110 %LE %LONG 0xffff5803; EMI_ARBC
;D.S SD:0x10205118 %LE %LONG 0x0601580e; EMI_ARBD
;D.S SD:0x10205120 %LE %LONG 0x40405003; EMI_ARBE
;D.S SD:0x10205128 %LE %LONG 0x8080500f; EMI_ARBF
;D.S SD:0x10205130 %LE %LONG 0x8080500f; EMI_ARBG
;D.S SD:0x10205148 %LE %LONG 0x00464f2f; EMI_ARBJ
;D.S SD:0x10205150 %LE %LONG 0x00720038; EMI_ARBK
;D.S SD:0x10205158 %LE %LONG 0x0808084d; EMI_SLCT

; DDRPHY setting
if &NR_RNKS==2
(
D.S SD:0x10208110 %LE %LONG 0x03051192;
)
else
(
D.S SD:0x10208110 %LE %LONG 0x00051180;
)
D.S SD:0x10208048 %LE %LONG 0x0001110d;
D.S SD:0x102080D8 %LE %LONG 0x00500900;
D.S SD:0x102080E4 %LE %LONG 0x00000000;
D.S SD:0x1020808c %LE %LONG 0x00000001;
D.S SD:0x10208090 %LE %LONG 0x00000000;
D.S SD:0x10208094 %LE %LONG 0x80000000;
D.S SD:0x102080DC %LE %LONG 0x83004004;
D.S SD:0x102080E0 %LE %LONG 0x01004004;
D.S SD:0x102080F0 %LE %LONG 0x00000000;
D.S SD:0x102080F4 %LE %LONG 0x01000000;
D.S SD:0x10208168 %LE %LONG 0x00000080;
D.S SD:0x102080D8 %LE %LONG 0x00700900;
D.S SD:0x10208004 %LE %LONG 0xF00487A2;
D.S SD:0x1020807C %LE %LONG 0x900641c0;
D.S SD:0x10208028 %LE %LONG 0xF1200F01;
D.S SD:0x102081E0 %LE %LONG 0x3001ebff;
D.S SD:0x10208158 %LE %LONG 0x00000000;
D.S SD:0x102080e4 %LE %LONG 0x00000005;
wait 1.ms
D.S SD:0x10208088 %LE %LONG 0x0000003F;
D.S SD:0x100F11E4 %LE %LONG 0x00000001;
D.S SD:0x100F11E4 %LE %LONG 0x00000000;
wait 1.ms
D.S SD:0x10208088 %LE %LONG 0x00FF000A;
D.S SD:0x100F11E4 %LE %LONG 0x00000001;
D.S SD:0x100F11E4 %LE %LONG 0x00000000;
wait 1.ms
D.S SD:0x10208088 %LE %LONG 0x00320001;
D.S SD:0x100F11E4 %LE %LONG 0x00000001;
D.S SD:0x100F11E4 %LE %LONG 0x00000000;
wait 1.ms
D.S SD:0x10208088 %LE %LONG 0x00020002;
D.S SD:0x100F11E4 %LE %LONG 0x00000001;
D.S SD:0x100F11E4 %LE %LONG 0x00001100;
wait 1.ms
;D.S SD:0x10208110 %LE %LONG 0x00111190;
D.S SD:0x102080E4 %LE %LONG 0x00000001;
D.S SD:0x10208084 %LE %LONG 0x00000a56;
D.S SD:0x1020800C %LE %LONG 0x00000000;
D.S SD:0x10208000 %LE %LONG 0x45D84408;
D.S SD:0x10208044 %LE %LONG 0xa8080401;
D.S SD:0x102081E8 %LE %LONG 0x00000510;
D.S SD:0x10208008 %LE %LONG 0x03406340;
D.S SD:0x10208010 %LE %LONG 0x00000000;
D.S SD:0x102080F8 %LE %LONG 0xEDCB000F;
D.S SD:0x102080FC %LE %LONG 0x27010000;

; DRAMC setting
if &NR_RNKS==2
(
D.S SD:0x10207110 %LE %LONG 0x03051192;
D.S SD:0x10207124 %LE %LONG 0xaa080000;
D.S SD:0x10207118 %LE %LONG 0x00000001;
)
else
(
D.S SD:0x10207110 %LE %LONG 0x00051180;
)
D.S SD:0x10207048 %LE %LONG 0x0001110d;
D.S SD:0x102070D8 %LE %LONG 0x00500900;
D.S SD:0x102070E4 %LE %LONG 0x00000000;
D.S SD:0x1020708c %LE %LONG 0x00000001;
D.S SD:0x10207090 %LE %LONG 0x00000000;
D.S SD:0x10207094 %LE %LONG 0x80000000;
D.S SD:0x102070DC %LE %LONG 0x83004004;
D.S SD:0x102070E0 %LE %LONG 0x01004004;
D.S SD:0x102070F0 %LE %LONG 0x00000000;
D.S SD:0x102070F4 %LE %LONG 0x01000000;
D.S SD:0x10207168 %LE %LONG 0x00000080;
D.S SD:0x102070D8 %LE %LONG 0x00700900;
D.S SD:0x10207004 %LE %LONG 0xF00487A2;
D.S SD:0x1020707C %LE %LONG 0x900641c0;
D.S SD:0x10207028 %LE %LONG 0xF1200F01;
D.S SD:0x102071E0 %LE %LONG 0x3001ebff;
D.S SD:0x10207158 %LE %LONG 0x00000000;
D.S SD:0x102070e4 %LE %LONG 0x00000005;
;wait 1.ms
D.S SD:0x10207088 %LE %LONG 0x0000003F;
D.S SD:0x102071E4 %LE %LONG 0x00000001;
D.S SD:0x102071E4 %LE %LONG 0x00000000;
D.S SD:0x102071E4 %LE %LONG 0x00000000;
D.S SD:0x102071E4 %LE %LONG 0x00000000;
D.S SD:0x102071E4 %LE %LONG 0x00000000;
D.S SD:0x102071E4 %LE %LONG 0x00000000;
D.S SD:0x102071E4 %LE %LONG 0x00000000;
D.S SD:0x102071E4 %LE %LONG 0x00000000;
D.S SD:0x102071E4 %LE %LONG 0x00000000;
D.S SD:0x102071E4 %LE %LONG 0x00000000;
D.S SD:0x102071E4 %LE %LONG 0x00000000;
;wait 1.ms
D.S SD:0x10207088 %LE %LONG 0x00FF000A;
D.S SD:0x102071E4 %LE %LONG 0x00000001;
D.S SD:0x102071E4 %LE %LONG 0x00000000;
D.S SD:0x102071E4 %LE %LONG 0x00000000;
D.S SD:0x102071E4 %LE %LONG 0x00000000;
D.S SD:0x102071E4 %LE %LONG 0x00000000;
D.S SD:0x102071E4 %LE %LONG 0x00000000;
D.S SD:0x102071E4 %LE %LONG 0x00000000;
D.S SD:0x102071E4 %LE %LONG 0x00000000;
D.S SD:0x102071E4 %LE %LONG 0x00000000;
D.S SD:0x102071E4 %LE %LONG 0x00000000;
D.S SD:0x102071E4 %LE %LONG 0x00000000;
;wait 1.ms
D.S SD:0x10207088 %LE %LONG 0x00320001;
D.S SD:0x102071E4 %LE %LONG 0x00000001;
D.S SD:0x102071E4 %LE %LONG 0x00000000;
D.S SD:0x102071E4 %LE %LONG 0x00000000;
D.S SD:0x102071E4 %LE %LONG 0x00000000;
D.S SD:0x102071E4 %LE %LONG 0x00000000;
D.S SD:0x102071E4 %LE %LONG 0x00000000;
D.S SD:0x102071E4 %LE %LONG 0x00000000;
D.S SD:0x102071E4 %LE %LONG 0x00000000;
D.S SD:0x102071E4 %LE %LONG 0x00000000;
D.S SD:0x102071E4 %LE %LONG 0x00000000;
D.S SD:0x102071E4 %LE %LONG 0x00000000;
;wait 1.ms
D.S SD:0x10207088 %LE %LONG 0x00020002;
D.S SD:0x102071E4 %LE %LONG 0x00000001;
D.S SD:0x102071E4 %LE %LONG 0x00001100;
D.S SD:0x102071E4 %LE %LONG 0x00000000;
D.S SD:0x102071E4 %LE %LONG 0x00000000;
D.S SD:0x102071E4 %LE %LONG 0x00000000;
D.S SD:0x102071E4 %LE %LONG 0x00000000;
D.S SD:0x102071E4 %LE %LONG 0x00000000;
D.S SD:0x102071E4 %LE %LONG 0x00000000;
D.S SD:0x102071E4 %LE %LONG 0x00000000;
D.S SD:0x102071E4 %LE %LONG 0x00000000;
D.S SD:0x102071E4 %LE %LONG 0x00000000;
;wait 1.ms
;D.S SD:0x10207110 %LE %LONG 0x00111190;
D.S SD:0x102070E4 %LE %LONG 0x00000001;
D.S SD:0x10207084 %LE %LONG 0x00000a56;
D.S SD:0x1020700C %LE %LONG 0x00000000;
D.S SD:0x10207000 %LE %LONG 0x45D84408;
D.S SD:0x10207044 %LE %LONG 0xa8080401;
D.S SD:0x102071E8 %LE %LONG 0x00000510;
D.S SD:0x10207008 %LE %LONG 0x03406340;
D.S SD:0x10207010 %LE %LONG 0x00000000;
D.S SD:0x102070F8 %LE %LONG 0xEDCB000F;
D.S SD:0x102070FC %LE %LONG 0x27010000;
