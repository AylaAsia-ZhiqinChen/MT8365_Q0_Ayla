## kernel-4.14/arch/arm64/configs/aiot8362am3_64_bsp_defconfig
```kconfig
CONFIG_CROSS_COMPILE="aarch64-linux-android-"
# CONFIG_LOCALVERSION_AUTO is not set
# CONFIG_FHANDLE is not set
CONFIG_LOG_BUF_SHIFT=19
CONFIG_UCLAMP_TASK=y
CONFIG_UCLAMP_GROUPS_COUNT=32
CONFIG_UCLAMP_TASK_GROUP=y
CONFIG_CPUSETS=y
CONFIG_SCHED_TUNE=y
CONFIG_DEFAULT_USE_ENERGY_AWARE=y
# CONFIG_RD_BZIP2 is not set
# CONFIG_RD_LZMA is not set
# CONFIG_RD_XZ is not set
# CONFIG_RD_LZO is not set
# CONFIG_RD_LZ4 is not set
CONFIG_SYSCTL_SYSCALL=y
# CONFIG_SLUB_DEBUG is not set
CONFIG_CC_STACKPROTECTOR_STRONG=y
# CONFIG_VMAP_STACK is not set
# CONFIG_BLK_DEV_BSG is not set
CONFIG_ARCH_MEDIATEK=y
CONFIG_MACH_MT8167=y
CONFIG_SCHED_MC=y
CONFIG_NR_CPUS=4
CONFIG_PREEMPT=y
# CONFIG_BOUNCE is not set
CONFIG_ZSMALLOC=y
CONFIG_RANDOMIZE_BASE=y
CONFIG_CMDLINE="console=tty0 console=ttyMT0,921600n1 root=/dev/ram vmalloc=496M slub_max_order=0 slub_debug=O loglevel=8 initcall_debug gpt "
# CONFIG_EFI is not set
CONFIG_BUILD_ARM64_APPENDED_DTB_IMAGE=y
CONFIG_BUILD_ARM64_DTB_OVERLAY_IMAGE=y
CONFIG_BUILD_ARM64_APPENDED_DTB_IMAGE_NAMES="mediatek/mt8167_dtbo"
CONFIG_BUILD_ARM64_DTB_OVERLAY_IMAGE_NAMES="mediatek/aiot8362am3_64_bsp"
# CONFIG_CORE_DUMP_DEFAULT_ELF_HEADERS is not set
CONFIG_COMPAT=y
CONFIG_PM_DEBUG=y
CONFIG_PM_ADVANCED_DEBUG=y
CONFIG_CPU_FREQ=y
CONFIG_CPU_FREQ_GOV_POWERSAVE=y
CONFIG_CPU_FREQ_GOV_USERSPACE=y
CONFIG_CPU_FREQ_GOV_ONDEMAND=y
CONFIG_CPU_FREQ_GOV_INTERACTIVE=y
CONFIG_CPU_FREQ_GOV_SCHEDUTIL=y
CONFIG_CPUFREQ_DT=y
CONFIG_XFRM_MIGRATE=y
CONFIG_IP_PNP=y
CONFIG_IP_PNP_DHCP=y
CONFIG_IP_PNP_BOOTP=y
CONFIG_NET_IPIP=y
CONFIG_IP_MROUTE=y
CONFIG_IP_MROUTE_MULTIPLE_TABLES=y
CONFIG_IP_PIMSM_V1=y
CONFIG_IP_PIMSM_V2=y
CONFIG_SYN_COOKIES=y
CONFIG_INET_AH=y
CONFIG_INET_IPCOMP=y
CONFIG_INET6_AH=y
CONFIG_INET6_XFRM_MODE_ROUTEOPTIMIZATION=y
CONFIG_IPV6_SIT_6RD=y
CONFIG_IPV6_SUBTREES=y
CONFIG_IPV6_MROUTE=y
CONFIG_IPV6_PIMSM_V2=y
CONFIG_BRIDGE_NETFILTER=y
CONFIG_NETFILTER_XT_MATCH_CONNBYTES=y
CONFIG_NETFILTER_XT_MATCH_MULTIPORT=y
CONFIG_NETFILTER_XT_MATCH_PHYSDEV=y
CONFIG_NETFILTER_XT_MATCH_REALM=y
CONFIG_NETFILTER_XT_MATCH_RECENT=y
CONFIG_NETFILTER_XT_MATCH_TCPMSS=y
CONFIG_IP_NF_MATCH_AH=y
CONFIG_IP6_NF_MATCH_FRAG=y
CONFIG_IP6_NF_MATCH_IPV6HEADER=y
CONFIG_IP6_NF_TARGET_HL=y
CONFIG_BRIDGE=y
CONFIG_VLAN_8021Q=y
CONFIG_NET_CLS_FW=y
CONFIG_CLS_U32_PERF=y
CONFIG_CLS_U32_MARK=y
CONFIG_NET_CLS_FLOW=y
CONFIG_NET_ACT_POLICE=y
CONFIG_NET_ACT_MIRRED=y
CONFIG_NET_ACT_IPT=y
CONFIG_NET_CLS_IND=y
CONFIG_NET_DROP_MONITOR=y
CONFIG_CFG80211=y
CONFIG_NL80211_TESTMODE=y
CONFIG_CFG80211_DEVELOPER_WARNINGS=y
# CONFIG_CFG80211_DEFAULT_PS is not set
CONFIG_MTD=y
CONFIG_MTD_BLOCK=y
CONFIG_MTD_NAND=y
CONFIG_MTD_NAND_PLATFORM=y
CONFIG_ZRAM=y
CONFIG_BLK_DEV_LOOP=y
CONFIG_BLK_DEV_LOOP_MIN_COUNT=16
CONFIG_MEDIATEK_SOLUTION=y
CONFIG_MTK_PLATFORM="mt8167"
CONFIG_ARCH_MTK_PROJECT="aiot8362am3_64_bsp"
CONFIG_MTK_PSCI=y
CONFIG_MTK_GPT_SCHEME_SUPPORT=y
CONFIG_MTK_PMIC=y
CONFIG_MTK_HDMI_SUPPORT=y
CONFIG_MTK_INTERNAL_HDMI_SUPPORT=y
CONFIG_MTK_HDMI_HDCP_SUPPORT=y
CONFIG_CUSTOM_KERNEL_IMGSENSOR="ov5645_mipi_raw"
CONFIG_MTK_DRM_KEY_MNG_SUPPORT=y
CONFIG_MTK_CMDQ=y
CONFIG_MTK_CMDQ_TAB=y
CONFIG_MTK_IMGSENSOR=y
CONFIG_MTK_LCM=y
CONFIG_CUSTOM_KERNEL_LCM="ili9881c_hd720_td_tchd5031_6b_dsi_vdo"
CONFIG_MTK_FB=y
CONFIG_MTK_VIDEOX=y
CONFIG_MTK_LCM_PHYSICAL_ROTATION="0"
CONFIG_LCM_HEIGHT="1280"
CONFIG_LCM_WIDTH="720"
CONFIG_MTK_AAL_SUPPORT=y
# CONFIG_MMPROFILE is not set
CONFIG_MTK_SENSOR_SUPPORT=y
CONFIG_MTK_SENSORS_1_0=y
CONFIG_MTK_LIS3DH_NEW=y
CONFIG_MTK_HWMON=y
CONFIG_MTK_COMBO=y
CONFIG_MTK_COMBO_CHIP_MT7668=y
CONFIG_MTK_COMBO_COMM=y
CONFIG_MTK_COMBO_COMM_SDIO=y
CONFIG_MTK_COMBO_BT=y
CONFIG_MTK_COMBO_GPS=y
CONFIG_MTK_COMBO_WIFI=y
CONFIG_MTK_DHCPV6C_WIFI=y
CONFIG_MTK_FMRADIO=y
CONFIG_MTK_FM_CHIP="MT6630_FM"
CONFIG_MTK_MERGE_INTERFACE_SUPPORT=y
CONFIG_MTK_IN_HOUSE_TEE_SUPPORT=y
CONFIG_MTK_ACCDET=y
CONFIG_ACCDET_EINT=y
# CONFIG_MTK_M4U is not set
CONFIG_MTK_PSEUDO_M4U=y
# CONFIG_MTK_ATF_LOGGER is not set
CONFIG_MTK_LENS=y
CONFIG_MTK_LENS_DUMMYLENS_SUPPORT=y
CONFIG_MTK_LENS_WV511AAF_SUPPORT=y
CONFIG_MTK_LEDS=y
CONFIG_MTK_CHIP=y
CONFIG_MTK_IDLE_BALANCE_ENHANCEMENT=y
CONFIG_SCHED_HMP=y
CONFIG_MTK_SCHED_RQAVG_KS=y
CONFIG_MTK_SCHED_RQAVG_US=y
CONFIG_MTK_SCHED_CPULOAD=y
CONFIG_MTK_USBFSH=y
CONFIG_MTK_MUSBFSH_QMU_SUPPORT=y
CONFIG_USB_MTK_HDRC=y
CONFIG_MTK_MUSB_QMU_SUPPORT=y
CONFIG_USB_MTK_OTG=y
CONFIG_MTK_MUSB_PORT0_LOWPOWER_MODE=y
CONFIG_MTK_RAM_CONSOLE=y
CONFIG_MTK_AEE_FEATURE=y
CONFIG_MTK_AEE_AED=y
CONFIG_MTK_AEE_IPANIC=y
CONFIG_MTK_XO=y
CONFIG_MTPROF=y
CONFIG_ANDROID_DEFAULT_SETTING=y
CONFIG_MTK_FREQ_HOPPING=y
CONFIG_MTK_GPU_SUPPORT=y
CONFIG_MTK_GPU_VERSION="rgx clark 1.11ED"
CONFIG_MTK_GPU_COMMON_DVFS_SUPPORT=y
CONFIG_MTK_SYNC=y
CONFIG_MTK_VIDEOCODEC_DRIVER=y
CONFIG_SCSI=y
CONFIG_BLK_DEV_SD=y
CONFIG_SCSI_SCAN_ASYNC=y
# CONFIG_SCSI_LOWLEVEL is not set
CONFIG_MD=y
CONFIG_BLK_DEV_DM=y
CONFIG_DM_CRYPT=y
CONFIG_DM_UEVENT=y
CONFIG_DM_VERITY=y
CONFIG_DM_VERITY_FEC=y
CONFIG_DM_BOW=y
CONFIG_IFB=y
# CONFIG_ETHERNET is not set
CONFIG_PPP_FILTER=y
CONFIG_PPP_MULTILINK=y
CONFIG_PPPOE=y
CONFIG_PPP_ASYNC=y
CONFIG_PPP_SYNC_TTY=y
CONFIG_USB_USBNET=y
CONFIG_INPUT_EVDEV=y
CONFIG_KEYBOARD_MTK=y
CONFIG_KEYBOARD_MTK_PMIC=y
CONFIG_INPUT_TOUCHSCREEN=y
CONFIG_TOUCHSCREEN_MTK=y
CONFIG_TOUCHSCREEN_MTK_GT9157=y
CONFIG_INPUT_MISC=y
CONFIG_INPUT_UINPUT=y
# CONFIG_VT is not set
CONFIG_LEGACY_PTY_COUNT=16
# CONFIG_DEVMEM is not set
CONFIG_SERIAL_8250=y
CONFIG_SERIAL_8250_CONSOLE=y
CONFIG_SERIAL_8250_NR_UARTS=3
CONFIG_SERIAL_8250_RUNTIME_UARTS=3
CONFIG_SERIAL_8250_MT6577=y
# CONFIG_HW_RANDOM is not set
CONFIG_I2C_MT65XX=y
CONFIG_SPI=y
CONFIG_SPI_MT65XX=y
# CONFIG_PINCTRL_MT8173 is not set
# CONFIG_PINCTRL_MT8183 is not set
CONFIG_MTK_GAUGE_VERSION=10
CONFIG_POWER_EXT=y
# CONFIG_HWMON is not set
CONFIG_THERMAL=y
CONFIG_THERMAL_DEFAULT_GOV_BACKWARD_COMPATIBLE=y
CONFIG_WATCHDOG=y
CONFIG_MEDIATEK_WATCHDOG=y
# CONFIG_MTK_WATCHDOG is not set
# CONFIG_MTK_WD_KICKER is not set
CONFIG_MFD_MT6397=y
CONFIG_MT6397_MISC=y
CONFIG_REGULATOR=y
CONFIG_REGULATOR_FIXED_VOLTAGE=y
CONFIG_REGULATOR_MT6392=y
# CONFIG_RC_MAP is not set
CONFIG_LIRC=y
# CONFIG_IR_LIRC_CODEC is not set
# CONFIG_IR_NEC_DECODER is not set
# CONFIG_IR_RC5_DECODER is not set
# CONFIG_IR_RC6_DECODER is not set
# CONFIG_IR_JVC_DECODER is not set
# CONFIG_IR_SONY_DECODER is not set
# CONFIG_IR_SANYO_DECODER is not set
# CONFIG_IR_MCE_KBD_DECODER is not set
CONFIG_MEDIA_SUPPORT=y
CONFIG_MEDIA_CAMERA_SUPPORT=y
CONFIG_MEDIA_USB_SUPPORT=y
CONFIG_USB_VIDEO_CLASS=y
CONFIG_DRM=y
CONFIG_FB_MODE_HELPERS=y
CONFIG_FB_TILEBLITTING=y
CONFIG_LOGO=y
CONFIG_SOUND=y
CONFIG_SND=y
CONFIG_SND_HRTIMER=y
CONFIG_SND_DYNAMIC_MINORS=y
CONFIG_SND_VERBOSE_PRINTK=y
CONFIG_SND_DEBUG=y
CONFIG_SND_DEBUG_VERBOSE=y
CONFIG_SND_PCM_XRUN_DEBUG=y
CONFIG_SND_SEQUENCER=y
CONFIG_SND_SEQ_DUMMY=y
# CONFIG_SND_SPI is not set
CONFIG_SND_USB_AUDIO=y
CONFIG_SND_SOC=y
CONFIG_SND_SOC_MT8167S_SOM_MACH=y
CONFIG_SND_SOC_MTK_BTCVSD=y
CONFIG_SND_SIMPLE_CARD=y
CONFIG_HIDRAW=y
CONFIG_UHID=y
CONFIG_HID_A4TECH=y
CONFIG_HID_APPLE=y
CONFIG_HID_BELKIN=y
CONFIG_HID_CHERRY=y
CONFIG_HID_CHICONY=y
CONFIG_HID_CYPRESS=y
CONFIG_HID_DRAGONRISE=y
CONFIG_HID_EZKEY=y
CONFIG_HID_KYE=y
CONFIG_HID_GYRATION=y
CONFIG_HID_TWINHAN=y
CONFIG_HID_KENSINGTON=y
CONFIG_HID_LOGITECH=y
CONFIG_HID_MAGICMOUSE=y
CONFIG_HID_MICROSOFT=y
CONFIG_HID_MONTEREY=y
CONFIG_HID_PANTHERLORD=y
CONFIG_HID_PETALYNX=y
CONFIG_HID_SAMSUNG=y
CONFIG_HID_SUNPLUS=y
CONFIG_HID_GREENASIA=y
CONFIG_HID_SMARTJOYPLUS=y
CONFIG_HID_TOPSEED=y
CONFIG_HID_THRUSTMASTER=y
CONFIG_HID_ZEROPLUS=y
CONFIG_USB=y
CONFIG_USB_STORAGE=y
CONFIG_USB_STORAGE_DATAFAB=y
CONFIG_USB_STORAGE_FREECOM=y
CONFIG_USB_STORAGE_ISD200=y
CONFIG_USB_STORAGE_USBAT=y
CONFIG_USB_STORAGE_SDDR09=y
CONFIG_USB_STORAGE_SDDR55=y
CONFIG_USB_STORAGE_JUMPSHOT=y
CONFIG_USB_STORAGE_ALAUDA=y
CONFIG_USB_STORAGE_ONETOUCH=y
CONFIG_USB_STORAGE_KARMA=y
CONFIG_USB_STORAGE_CYPRESS_ATACB=y
CONFIG_USB_SERIAL=y
CONFIG_USB_SERIAL_OPTION=y
CONFIG_USB_TRANCEVIBRATOR=y
CONFIG_NOP_USB_XCEIV=y
CONFIG_DUAL_ROLE_USB_INTF=y
CONFIG_USB_CONFIGFS_SERIAL=y
CONFIG_USB_CONFIGFS_ACM=y
CONFIG_USB_CONFIGFS_RNDIS=y
CONFIG_USB_CONFIGFS_MASS_STORAGE=y
CONFIG_USB_CONFIGFS_F_HID=y
CONFIG_MMC=y
CONFIG_MMC_BLOCK_MINORS=32
CONFIG_MMC_MTK=y
CONFIG_MMC_MTK_COMM_SDIO=y
CONFIG_NEW_LEDS=y
CONFIG_LEDS_CLASS=y
CONFIG_LEDS_TRIGGERS=y
CONFIG_LEDS_TRIGGER_TIMER=y
# CONFIG_RTC_SYSTOHC is not set
CONFIG_RTC_DRV_MT6397=y
CONFIG_DMADEVICES=y
CONFIG_DMA_MTK_UART=y
CONFIG_SW_SYNC=y
CONFIG_ANDROID_INTF_ALARM_DEV=y
CONFIG_ION=y
CONFIG_MTK_ION=y
# CONFIG_COMMON_CLK_MT6797 is not set
# CONFIG_COMMON_CLK_MT8173 is not set
# CONFIG_COMMON_CLK_MT8168 is not set
# CONFIG_COMMON_CLK_MT8183 is not set
CONFIG_MAILBOX=y
CONFIG_MTK_CMDQ_MBOX=y
CONFIG_MTK_IOMMU=y
CONFIG_MTK_PMIC_WRAP=y
CONFIG_IIO=y
CONFIG_MEDIATEK_MT6577_AUXADC=y
CONFIG_RESET_CONTROLLER=y
CONFIG_EXT4_FS=y
CONFIG_EXT4_FS_SECURITY=y
CONFIG_EXT4_ENCRYPTION=y
CONFIG_QUOTA=y
CONFIG_QUOTA_NETLINK_INTERFACE=y
CONFIG_QFMT_V2=y
CONFIG_FUSE_FS=y
CONFIG_ISO9660_FS=y
CONFIG_JOLIET=y
CONFIG_ZISOFS=y
CONFIG_MSDOS_FS=y
CONFIG_VFAT_FS=y
CONFIG_TMPFS=y
CONFIG_SDCARD_FS=y
CONFIG_PSTORE=y
CONFIG_PSTORE_CONSOLE=y
CONFIG_PSTORE_PMSG=y
CONFIG_PSTORE_RAM=y
# CONFIG_NETWORK_FILESYSTEMS is not set
CONFIG_NLS_CODEPAGE_437=y
CONFIG_NLS_CODEPAGE_950=y
CONFIG_NLS_ASCII=y
CONFIG_NLS_ISO8859_1=y
CONFIG_NLS_UTF8=y
CONFIG_PRINTK_TIME=y
CONFIG_DYNAMIC_DEBUG=y
CONFIG_DEBUG_INFO=y
CONFIG_FRAME_WARN=4096
CONFIG_DEBUG_KMEMLEAK=y
CONFIG_DEBUG_KMEMLEAK_EARLY_LOG_SIZE=2400
CONFIG_DEBUG_KMEMLEAK_DEFAULT_OFF=y
CONFIG_PANIC_ON_OOPS=y
CONFIG_PANIC_TIMEOUT=5
CONFIG_SCHEDSTATS=y
# CONFIG_DEBUG_PREEMPT is not set
# CONFIG_DEBUG_BUGVERBOSE is not set
CONFIG_RCU_CPU_STALL_TIMEOUT=60
CONFIG_FAULT_INJECTION=y
CONFIG_ENABLE_DEFAULT_TRACERS=y
CONFIG_MTK_SCHED_TRACERS=y
CONFIG_SECURITY_SELINUX_BOOTPARAM=y
CONFIG_INTEGRITY_SIGNATURE=y
CONFIG_CRYPTO_TWOFISH=y
# CONFIG_CRYPTO_HW is not set
```

## kernel-4.14/drivers/input/touchscreen/mediatek/GT9110/Kconfig
```kconfig
#
# Touchscreen driver configuration
#
menu "GT9110 Touchscreen Config"
	depends on TOUCHSCREEN_MTK_GT9110

#if TOUCHSCREEN_MTK_GT9XX

config GTP_USE_PINCTRL
	bool "GT9110 GPIO use Pinctrl"
	default n
	help
	  Say Y here if you have GT9110 touch panel.

	  If unsure, say N.
	  This is a GT9110 config , you can config it
	  if you want to use.

config GTP_FIRMWARE
	string "GT9110 firmawre group"
	default "firmware"
	help
	  Say Y here if you have GT9110 touch panel.

	  If unsure, say N.
	  This is a GT9110 config , you can config it
	  if you want to use.

config GTP_CONFIG
	string "GT9110 config data group"
	default "config0"
	help
	  Say Y here if you have GT9110 touch panel.

	  If unsure, say N.
	  This is a GT9110 config , you can config it
	  if you want to use.


config GTP_DRIVER_SEND_CFG
	bool "GT9110 driver send config"
	default y
	help
	  Say Y here if you have GT9110 touch panel.

	  If unsure, say N.
	  This is a GT9110 config , you can config it
	  if you want to use.


config GTP_CUSTOM_CFG
	bool "GT9110 custom config"
	default n
	help
	  Say Y here if you have GT9110 touch panel.

	  If unsure, say N.
	  This is a GT9110 config , you can config it
	  if you want to use.


config GTP_HAVE_TOUCH_KEY
	bool "GT9110 touch key enable"
	default n
	help
	  Say Y here if you have GT9110 touch panel.

	  If unsure, say N.
	  This is a GT9110 config , you can config it
	  if you want to use.


config GTP_WITH_HOVER
	bool "GT9110 hover enable"
	default n
	help
	  Say Y here if you have GT9110 touch panel.

	  If unsure, say N.
	  This is a GT9110 config , you can config it
	  if you want to use.


config GTP_CHANGE_X2Y
	bool "GT9110 X2Y"
	default n
	help
	  Say Y here if you have GT9110 touch panel.

	  If unsure, say N.
	  This is a GT9110 config , you can config it
	  if you want to use.


config GTP_COMPATIBLE_MODE
	bool "GT9110 flahless compatible"
	default n
	help
	  Say Y here if you have GT9110 touch panel.

	  If unsure, say N.
	  This is a GT9110 config , you can config it
	  if you want to use.


config GTP_WARP_X_ON
	bool "GT9110 swap x"
	default n
	help
	  Say Y here if you have GT9110 touch panel.

	  If unsure, say N.
	  This is a GT9110 config , you can config it
	  if you want to use.


config GTP_WARP_Y_ON
	bool "GT9110 swap y"
	default n
	help
	  Say Y here if you have GT9110 touch panel.

	  If unsure, say N.
	  This is a GT9110 config , you can config it
	  if you want to use.


config GTP_GESTURE_WAKEUP
	bool "GT9110 gesture wakeup"
	default n
	help
	  Say Y here if you have GT9110 touch panel.

	  If unsure, say N.
	  This is a GT9110 config , you can config it
	  if you want to use.


config GTP_HOTKNOT
	bool "GT9110 hotknot"
	default n
	help
	  Say Y here if you have GT9110 touch panel.

	  If unsure, say N.
	  This is a GT9110 config , you can config it
	  if you want to use.


config HOTKNOT_BLOCK_RW
	bool "GT9110 hotknot blocking rw"
	default n
	help
	  Say Y here if you have GT9110 touch panel.

	  If unsure, say N.
	  This is a GT9110 config , you can config it
	  if you want to use.


config GTP_PROXIMITY
	bool "GT9110 proximity"
	default n
	help
	  Say Y here if you have GT9110 touch panel.

	  If unsure, say N.
	  This is a GT9110 config , you can config it
	  if you want to use.


config GTP_AUTO_UPDATE
	bool "GT9110 firmware auto update"
	default n
	help
	  Say Y here if you have GT9110 touch panel.

	  If unsure, say N.
	  This is a GT9110 config , you can config it
	  if you want to use.


config GTP_AUTO_UPDATE_CFG
	bool "GT9110 config data auto update"
	default n
	help
	  Say Y here if you have GT9110 touch panel.

	  If unsure, say N.
	  This is a GT9110 config , you can config it
	  if you want to use.


config GTP_REQUEST_FW_UPDATE
	bool "GT9110 firmware in request firmware"
	default n
	help
	  Say Y here if you have GT9110 touch panel.

	  If unsure, say N.
	  This is a GT9110 config , you can config it
	  if you want to use.


config GTP_SUPPORT_I2C_DMA
	bool "GT9110 support i2c dma"
	default n
	help
	  Say Y here if you have GT9110 touch panel.

	  If unsure, say N.
	  This is a GT9110 config , you can config it
	  if you want to use.


config GTP_CREATE_WR_NODE
	bool "GT9110 create debug node"
	default y
	help
	  Say Y here if you have GT9110 touch panel.

	  If unsure, say N.
	  This is a GT9110 config , you can config it
	  if you want to use.


config GTP_ESD_PROTECT
	bool "GT9110 esd protection"
	default y
	help
	  Say Y here if you have GT9110 touch panel.

	  If unsure, say N.
	  This is a GT9110 config , you can config it
	  if you want to use.


config GTP_CHARGER_DETECT
	bool "GT9110 charger detection"
	default n
	help
	  Say Y here if you have GT9110 touch panel.

	  If unsure, say N.
	  This is a GT9110 config , you can config it
	  if you want to use.


config GTP_CHARGER_SWITCH
	bool "GT9110 for Mediatek package"
	default n
	help
	  Say Y here if you have GT9110 touch panel.

	  If unsure, say N.
	  This is a GT9110 config , you can config it
	  if you want to use.


config GTP_DEBUG_ARRAY_ON
	bool "GT9110 debug array"
	default n
	help
	  Say Y here if you have GT9110 touch panel.

	  If unsure, say N.
	  This is a GT9110 config , you can config it
	  if you want to use.


config GTP_DEBUG_FUNC_ON
	bool "GT9110 debug func on"
	default n
	help
	  Say Y here if you have GT9110 touch panel.

	  If unsure, say N.
	  This is a GT9110 config , you can config it
	  if you want to use.


config GTP_DEBUG_ON
	bool "GT9110 debug on"
	default n
	help
	  Say Y here if you have GT9110 touch panel.

	  If unsure, say N.
	  This is a GT9110 config , you can config it
	  if you want to use.


config GTP_POWER_CTRL_SLEEP
	bool "GT9110 power down when sleeping"
	default n
	help
	  Say Y here if you have GT9110 touch panel.

	  If unsure, say N.
	  This is a GT9110 config , you can config it
	  if you want to use.


#endif
endmenu
```
